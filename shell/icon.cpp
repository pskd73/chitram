#include "icon.h"
#include "display.h"
#include "ui_clip.h"

#include <Adafruit_ILI9341.h>
#include <string.h>

// Each icon: 16×16, MSB left, 2 bytes/row, PROGMEM.
// Designed as simple line glyphs readable at small size.

static const uint8_t PROGMEM kBmpHome[] = {
    0x01, 0x80, 0x03, 0xC0, 0x07, 0xE0, 0x0F, 0xF0, 0x1F, 0xF8, 0x3F, 0xFC,
    0x7F, 0xFE, 0xFF, 0xFF, 0x3C, 0x3C, 0x3C, 0x3C, 0x3C, 0x3C, 0x3C, 0x3C,
    0x3C, 0x3C, 0x3F, 0xFC, 0x3F, 0xFC, 0x00, 0x00,
};

static const uint8_t PROGMEM kBmpMic[] = {
    0x01, 0x80, 0x03, 0xC0, 0x03, 0xC0, 0x03, 0xC0, 0x03, 0xC0, 0x03, 0xC0,
    0x03, 0xC0, 0x07, 0xE0, 0x0C, 0x30, 0x18, 0x18, 0x18, 0x18, 0x0C, 0x30,
    0x07, 0xE0, 0x01, 0x80, 0x01, 0x80, 0x07, 0xE0,
};

// Filled circle — record / listening indicator
static const uint8_t PROGMEM kBmpRecord[] = {
    0x00, 0x00, 0x03, 0xC0, 0x0F, 0xF0, 0x1F, 0xF8, 0x3F, 0xFC, 0x3F, 0xFC,
    0x7F, 0xFE, 0x7F, 0xFE, 0x7F, 0xFE, 0x7F, 0xFE, 0x3F, 0xFC, 0x3F, 0xFC,
    0x1F, 0xF8, 0x0F, 0xF0, 0x03, 0xC0, 0x00, 0x00,
};

// Circular arcs — loading / busy
static const uint8_t PROGMEM kBmpLoading[] = {
    0x03, 0xC0, 0x0C, 0x30, 0x10, 0x08, 0x20, 0x04, 0x20, 0x04, 0x40, 0x00,
    0x40, 0x00, 0x40, 0x00, 0x40, 0x00, 0x40, 0x02, 0x20, 0x04, 0x20, 0x04,
    0x10, 0x08, 0x0C, 0x30, 0x03, 0xC0, 0x00, 0x00,
};

// Brain silhouette (two lobes + cleft) — thinking
static const uint8_t PROGMEM kBmpBrain[] = {
    0x07, 0xE0, // .....######.....
    0x1F, 0xF8, // ...##########...
    0x3E, 0x7C, // ..#####..#####..
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    0x01, 0x80, // .......##.......
};

static const uint8_t PROGMEM kBmpChat[] = {
    0x1F, 0xF8, 0x3F, 0xFC, 0x7F, 0xFE, 0x7F, 0xFE, 0x7F, 0xFE, 0x7F, 0xFE,
    0x7F, 0xFE, 0x7F, 0xFE, 0x3F, 0xFC, 0x1F, 0xF8, 0x06, 0x00, 0x07, 0x00,
    0x03, 0x80, 0x01, 0x80, 0x00, 0x00, 0x00, 0x00,
};

static const uint8_t PROGMEM kBmpGallery[] = {
    0xFF, 0xFF, 0x80, 0x01, 0x80, 0x01, 0x9C, 0x01, 0xBE, 0x01, 0xBF, 0x01,
    0x80, 0x01, 0x80, 0x61, 0x80, 0xF1, 0x81, 0xF9, 0x83, 0xFD, 0x87, 0xFF,
    0x8F, 0xFF, 0x80, 0x01, 0x80, 0x01, 0xFF, 0xFF,
};

static const uint8_t PROGMEM kBmpGear[] = {
    0x01, 0x80, 0x0D, 0xB0, 0x1D, 0xB8, 0x39, 0x9C, 0x70, 0x0E, 0x60, 0x06,
    0xC3, 0xC3, 0xC7, 0xE3, 0xC7, 0xE3, 0xC3, 0xC3, 0x60, 0x06, 0x70, 0x0E,
    0x39, 0x9C, 0x1D, 0xB8, 0x0D, 0xB0, 0x01, 0x80,
};

static const uint8_t PROGMEM kBmpInfo[] = {
    0x07, 0xE0, 0x1F, 0xF8, 0x38, 0x1C, 0x60, 0x06, 0x60, 0x06, 0x61, 0x86,
    0x61, 0x86, 0x60, 0x06, 0x61, 0x86, 0x61, 0x86, 0x61, 0x86, 0x61, 0x86,
    0x60, 0x06, 0x38, 0x1C, 0x1F, 0xF8, 0x07, 0xE0,
};

static const uint8_t PROGMEM kBmpWifi[] = {
    0x00, 0x00, 0x07, 0xE0, 0x1F, 0xF8, 0x38, 0x1C, 0x67, 0xE6, 0x0F, 0xF0,
    0x1C, 0x38, 0x03, 0xC0, 0x07, 0xE0, 0x01, 0x80, 0x01, 0x80, 0x01, 0x80,
    0x00, 0x00, 0x00, 0x00, 0x00, 0x00, 0x00, 0x00,
};

static const uint8_t PROGMEM kBmpStorage[] = {
    0x3F, 0xFC, 0x40, 0x02, 0x80, 0x01, 0x80, 0x01, 0x9F, 0xF9, 0x90, 0x09,
    0x90, 0x09, 0x9F, 0xF9, 0x80, 0x01, 0x80, 0x01, 0x9F, 0xF9, 0x90, 0x09,
    0x90, 0x09, 0x9F, 0xF9, 0x80, 0x01, 0x7F, 0xFE,
};

static const uint8_t PROGMEM kBmpDisplay[] = {
    0xFF, 0xFF, 0x80, 0x01, 0x80, 0x01, 0x80, 0x01, 0x80, 0x01, 0x80, 0x01,
    0x80, 0x01, 0x80, 0x01, 0x80, 0x01, 0x80, 0x01, 0x80, 0x01, 0x80, 0x01,
    0xFF, 0xFF, 0x01, 0x80, 0x07, 0xE0, 0x00, 0x00,
};

static const uint8_t PROGMEM kBmpSound[] = {
    0x00, 0x40, 0x00, 0xC0, 0x01, 0xC0, 0x03, 0xC0, 0x07, 0xC8, 0x0F, 0xCC,
    0xFF, 0xCE, 0xFF, 0xCF, 0xFF, 0xCF, 0xFF, 0xCE, 0x0F, 0xCC, 0x07, 0xC8,
    0x03, 0xC0, 0x01, 0xC0, 0x00, 0xC0, 0x00, 0x40,
};

static const uint8_t PROGMEM kBmpDebug[] = {
    0x00, 0x00, 0x18, 0x18, 0x0C, 0x30, 0x06, 0x60, 0x03, 0xC0, 0x01, 0x80,
    0x3F, 0xFC, 0x20, 0x04, 0x27, 0xE4, 0x24, 0x24, 0x27, 0xE4, 0x20, 0x04,
    0x3F, 0xFC, 0x01, 0x80, 0x01, 0x80, 0x00, 0x00,
};

static const uint8_t PROGMEM kBmpCheck[] = {
    0x00, 0x00, 0x00, 0x03, 0x00, 0x06, 0x00, 0x0C, 0x00, 0x18, 0x00, 0x30,
    0x00, 0x60, 0xC0, 0xC0, 0x61, 0x80, 0x33, 0x00, 0x1E, 0x00, 0x0C, 0x00,
    0x00, 0x00, 0x00, 0x00, 0x00, 0x00, 0x00, 0x00,
};

static const uint8_t PROGMEM kBmpBack[] = {
    0x00, 0x00, 0x02, 0x00, 0x06, 0x00, 0x0E, 0x00, 0x1E, 0x00, 0x3F, 0xFE,
    0x7F, 0xFE, 0x3F, 0xFE, 0x1E, 0x00, 0x0E, 0x00, 0x06, 0x00, 0x02, 0x00,
    0x00, 0x00, 0x00, 0x00, 0x00, 0x00, 0x00, 0x00,
};

// Trash bin: lid + can with vertical ribs
static const uint8_t PROGMEM kBmpBin[] = {
    0x06, 0x00, 0x0F, 0xF0, 0x1F, 0xF8, 0x3F, 0xFC, 0x20, 0x04, 0x24, 0x24,
    0x24, 0x24, 0x24, 0x24, 0x24, 0x24, 0x24, 0x24, 0x24, 0x24, 0x20, 0x04,
    0x3F, 0xFC, 0x1F, 0xF8, 0x0F, 0xF0, 0x00, 0x00,
};

// Magnifying glass with + (zoom in)
static const uint8_t PROGMEM kBmpZoomIn[] = {
    0x1F, 0x00, // ...#####........
    0x20, 0x80, // ..#.....#.......
    0x40, 0x40, // .#.......#......
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    0x00, 0x00,
};

// Magnifying glass with − (zoom out)
static const uint8_t PROGMEM kBmpZoomOut[] = {
    0x1F, 0x00, // ...#####........
    0x20, 0x80, // ..#.....#.......
    0x40, 0x40, // .#.......#......
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    0x00, 0x00,
};

struct IconEntry {
  const char *id;
  const uint8_t *bitmap;
};

static const IconEntry kIcons[] = {
    {"home", kBmpHome},
    {"chat", kBmpChat},
    {"message", kBmpChat},
    {"ask", kBmpChat},
    {"mic", kBmpMic},
    {"talk", kBmpMic},
    {"record", kBmpRecord},
    {"rec", kBmpRecord},
    {"loading", kBmpLoading},
    {"wait", kBmpLoading},
    {"busy", kBmpLoading},
    {"brain", kBmpBrain},
    {"think", kBmpBrain},
    {"thinking", kBmpBrain},
    {"gallery", kBmpGallery},
    {"image", kBmpGallery},
    {"gear", kBmpGear},
    {"settings", kBmpGear},
    {"info", kBmpInfo},
    {"about", kBmpInfo},
    {"wifi", kBmpWifi},
    {"storage", kBmpStorage},
    {"display", kBmpDisplay},
    {"sound", kBmpSound},
    {"debug", kBmpDebug},
    {"check", kBmpCheck},
    {"back", kBmpBack},
    {"bin", kBmpBin},
    {"trash", kBmpBin},
    {"delete", kBmpBin},
    {"zoom_in", kBmpZoomIn},
    {"zoomin", kBmpZoomIn},
    {"zoom_out", kBmpZoomOut},
    {"zoomout", kBmpZoomOut},
};

static const uint8_t *findBitmap(const char *id) {
  if (!id || !id[0]) {
    return nullptr;
  }
  for (size_t i = 0; i < sizeof(kIcons) / sizeof(kIcons[0]); ++i) {
    if (strcmp(kIcons[i].id, id) == 0) {
      return kIcons[i].bitmap;
    }
  }
  return nullptr;
}

Icon::Icon(const char *id) : id_(id ? id : ""), bitmap_(findBitmap(id)) {}

bool Icon::exists(const char *id) { return findBitmap(id) != nullptr; }

bool Icon::draw(int16_t x, int16_t y, uint16_t color) const {
  if (!bitmap_) {
    return false;
  }
  int16_t y0, y1;
  if (!uiClipSpan(y, kSize, &y0, &y1)) {
    return true;
  }
  reclaimDisplay();
  const int first = y0 - y;
  const int rows = y1 - y0;
  if (first == 0 && rows == kSize) {
    tft.drawBitmap(x, y, bitmap_, kSize, kSize, color);
  } else {
    // 16-wide → 2 bytes per row
    tft.drawBitmap(x, y0, bitmap_ + first * 2, kSize, rows, color);
  }
  return true;
}

bool Icon::draw(int16_t x, int16_t y, uint16_t fg, uint16_t bg) const {
  if (!bitmap_) {
    return false;
  }
  int16_t y0, y1;
  if (!uiClipSpan(y, kSize, &y0, &y1)) {
    return true;
  }
  reclaimDisplay();
  const int first = y0 - y;
  const int rows = y1 - y0;
  if (first == 0 && rows == kSize) {
    tft.drawBitmap(x, y, bitmap_, kSize, kSize, fg, bg);
  } else {
    tft.drawBitmap(x, y0, bitmap_ + first * 2, kSize, rows, fg, bg);
  }
  return true;
}

bool Icon::draw(const char *id, int16_t x, int16_t y, uint16_t color) {
  return Icon(id).draw(x, y, color);
}

bool Icon::draw(const char *id, int16_t x, int16_t y, uint16_t fg,
                uint16_t bg) {
  return Icon(id).draw(x, y, fg, bg);
}
